/*
 * tft.c
 *
 *  Created on: May 4, 2025
 *      Author: user
 */
#include "tft.h"

static const uint16_t fdata [] = {
0x0000, 0x0000, 0x0000, 0x0000, 0x0000, 0x0000, 0x0000, 0x0000, 0x0000, 0x0000,  // sp
0x1000, 0x1000, 0x1000, 0x1000, 0x1000, 0x1000, 0x0000, 0x1000, 0x0000, 0x0000,  // !
0x2800, 0x2800, 0x2800, 0x0000, 0x0000, 0x0000, 0x0000, 0x0000, 0x0000, 0x0000,  // "
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0x0000, 0x0000, 0x0000, 0x7400, 0x4C00, 0x0000, 0x0000, 0x0000, 0x0000, 0x0000,  // ~
};

void tft_send_data(tft_t *tft, uint8_t data) {
    HAL_GPIO_WritePin(tft->dc_port, tft->dc_pin, GPIO_PIN_SET);
    HAL_SPI_Transmit(tft->hspi, &data, 1, HAL_MAX_DELAY);
}

void tft_send_cmd(tft_t *tft, uint8_t cmd) {
	HAL_GPIO_WritePin(tft->dc_port, tft->dc_pin, GPIO_PIN_RESET);
	HAL_SPI_Transmit(tft->hspi, &cmd, 1, HAL_MAX_DELAY);
}

void tft_cs_high(tft_t *tft) {
	HAL_GPIO_WritePin(tft->cs_port, tft->cs_pin, GPIO_PIN_SET);
}

void tft_cs_low(tft_t *tft) {
	HAL_GPIO_WritePin(tft->cs_port, tft->cs_pin, GPIO_PIN_RESET);
}

void tft_init(tft_t *tft, SPI_HandleTypeDef *hspi, GPIO_TypeDef *reset_port, uint16_t reset_pin, GPIO_TypeDef *dc_port, uint16_t dc_pin, GPIO_TypeDef *cs_port, uint16_t cs_pin) {
    tft->hspi = hspi;
    tft->reset_port = reset_port;
    tft->reset_pin = reset_pin;
    tft->dc_port = dc_port;
    tft->dc_pin = dc_pin;
    tft->cs_port = cs_port;
    tft->cs_pin = cs_pin;

    HAL_GPIO_WritePin(reset_port, reset_pin, GPIO_PIN_RESET);
    HAL_Delay(20);
    HAL_GPIO_WritePin(reset_port, reset_pin, GPIO_PIN_SET);
    HAL_Delay(20);

    tft_cs_low(tft);
    tft_send_cmd(tft, 0x11);
    HAL_Delay(10);
    tft_send_cmd(tft, 0x3A);
    tft_send_data(tft, 0x05);
    tft_send_cmd(tft, 0x36);
    tft_send_data(tft, 0x14);
    tft_send_cmd(tft, 0x29);
    tft_cs_high(tft);
}

void tft_set_addr_window(tft_t *tft, uint8_t x0, uint8_t y0, uint8_t x1, uint8_t y1) {
    tft_cs_low(tft);
    tft_send_cmd(tft, ST_CASET); // Column addr set
    tft_send_data(tft, 0x00);
    tft_send_data(tft, x0); // XSTART
    tft_send_data(tft, 0x00);
    tft_send_data(tft, x1);      // XEND
    tft_send_cmd(tft, ST_RASET); // Row addr set
    tft_send_data(tft, 0x00);
    tft_send_data(tft, y0); // YSTART
    tft_send_data(tft, 0x00);
    tft_send_data(tft, y1);      // YEND
    tft_send_cmd(tft, ST_RAMWR); // write to RAM
    tft_cs_high(tft);
}

void tft_fill_rect(tft_t *tft, int16_t x, int16_t y, int16_t w, int16_t h, uint16_t color) {
    uint8_t hi = color >> 8, lo = color;

    if ((x >= ST_WIDTH) || (y >= ST_HEIGHT))
    {
        return;
    }
    if ((x + w - 1) >= ST_WIDTH)
    {
        w = ST_WIDTH - x;
    }
    if ((y + h - 1) >= ST_HEIGHT)
    {
        h = ST_HEIGHT - y;
    }

    tft_set_addr_window(tft, x, y, x + w - 1, y + h - 1);

    tft_cs_low(tft);
    for (y = h; y > 0; y--)
    {
        for (x = w; x > 0; x--)
        {
            tft_send_data(tft, hi);
            tft_send_data(tft, lo);
        }
    }
    tft_cs_high(tft);
}

void tft_write_char(tft_t* tft, char c, uint16_t tcolor, uint16_t bcolor) {
    uint32_t i, j, b;

    tft_cs_low(tft);
    for (i = 0; i < 10; i++)
    {
        b = fdata[(c - 32) * 10 + i];

        for (j = 0; j < 7; j++)
        {
            if ((b << j) & 0x8000)
            {
                tft_send_data(tft, tcolor >> 8);
                tft_send_data(tft, tcolor & 0xFF);
            }
            else
            {
                tft_send_data(tft, bcolor >> 8);
                tft_send_data(tft, bcolor & 0xFF);
            }
        }
    }
    tft_cs_high(tft);
}

void tft_write_string(tft_t* tft, uint8_t x, uint8_t y, char* str, uint16_t tcolor, uint16_t bcolor) {
    uint8_t _x = x;
    uint32_t i = 0;
    while (*str != 0)
    {
        tft_set_addr_window(tft, _x, y, 6+_x, 9+y);
        if (!((*str == '\r') || (*str == '\n')))
        {
        	tft_write_char(tft, *str, tcolor, bcolor);
        	_x += 7;
        	i++;
        }
        str++;
        if (i > 17)
        {
            i = 0;
            y += 10;
            _x = x;
        }
        else if (*str == '\r')
        {
        	_x = x;
        	i = 0;
        }
        else if (*str == '\n')
        {
        	y += 10;
        	i = 0;
        }
        else if (*str == '\t')
        {
        	*str = ' ';
        }
    }
}

void tft_write_num(tft_t* tft, uint8_t x, uint8_t y, int num, uint16_t tcolor, uint16_t bcolor) {
	char buffer[16];
	memset(buffer, 0, 16);
	sprintf(buffer, "%d", num);
	tft_write_string(tft, x, y, buffer, tcolor, bcolor);
}

void tft_new_bar(tft_t *tft, uint16_t barcolor, uint8_t ypos)  {

	uint8_t lowcolor = barcolor;
	uint8_t hicolor  = (barcolor >> 8);

	tft_set_addr_window(tft, 0, ypos, ST_WIDTH, 15+ypos);
	tft_cs_low(tft);
	for (int i = 0; i < ST_WIDTH; i++) {
		tft_send_data(tft, hicolor);
		tft_send_data(tft, lowcolor);
	}
	tft_cs_high(tft);
	tft_set_addr_window(tft, 0, ypos, 0, 15+ypos);
	tft_cs_low(tft);
	for (int i = 0; i < 15; i++) {
		tft_send_data(tft, hicolor);
		tft_send_data(tft, lowcolor);
	}
	tft_cs_high(tft);
	tft_set_addr_window(tft, 0, ypos+15, ST_WIDTH, 15+ypos);
	tft_cs_low(tft);
	for (int i = 0; i < ST_WIDTH; i++) {
		tft_send_data(tft, hicolor);
		tft_send_data(tft, lowcolor);
	}
	tft_cs_high(tft);
	tft_set_addr_window(tft, ST_WIDTH, ypos, ST_WIDTH, 15+ypos);
	tft_cs_low(tft);
	for (int i = 0; i < 15; i++) {
		tft_send_data(tft, hicolor);
		tft_send_data(tft, lowcolor);
	}
	tft_cs_high(tft);
}


